## boards/shields/capricorne/Kconfig.defconfig
```kconfig
if SHIELD_CORNECAVE_LEFT

config ZMK_KEYBOARD_NAME
    default "CorneCave"

config ZMK_SPLIT_ROLE_CENTRAL
    default y

config ZMK_USB
    default y

endif

if SHIELD_CORNECAVE_LEFT || SHIELD_CORNECAVE_RIGHT

config ZMK_SPLIT
    default y

endif
```

## boards/shields/cornecave/Kconfig.shield
```kconfig
config SHIELD_CORNECAVE_LEFT
    def_bool $(shields_list_contains,cornecave_left)

config SHIELD_CORNECAVE_RIGHT
    def_bool $(shields_list_contains,cornecave_right)
```
